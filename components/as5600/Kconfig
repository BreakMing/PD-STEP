## components/as5600/Kconfig
```kconfig
menu "AS5600 Encoder"

config AS5600_INVERT_DIR
    bool "Invert encoder counting direction"
    default y
    help
        Mirror the 12-bit raw angle so the reported position INCREASES
        when the motor moves in its +X (DIR high) direction.

        The raw angle's sense depends on how the magnet is mounted on
        the shaft — flipping the magnet 180 degrees reverses it.  This
        is a mounting calibration, not a defect.

        On this build: ENABLED.  Measured 2026-09-17: "G1 X120 F1200"
        made the commanded position go +120 mm while the encoder
        reported -117 mm, i.e. the raw angle counts DOWN for a +X move.
        Re-check this setting if the magnet is re-mounted, the motor is
        rewired, or $10 (invert_dir) is changed — $10 flips the motor's
        physical direction, which flips the encoder sense as well.

        Implementation: applied in as5600_read_raw() (driver layer), so
        the pure-logic tracker and its test cases are unaffected.

endmenu
```

## components/bsp/Kconfig
```kconfig
menu "BSP - Board Support Package"

    # ------------------------------------------------------------------
    # UART1 (protocol channel - host communication)
    # ------------------------------------------------------------------
    config BSP_UART1_TX_GPIO
        int "UART1 TX GPIO (protocol channel)"
        default 41
        help
            GPIO for UART1 TX (host protocol channel via CH343P).
            Changed from GPIO10 to GPIO41 (2026-09-12): GPIO10 has an
            on-board LED (idle-high = always lit); GPIO41/42 chosen from
            the free pin pool (IO7/IO3/IO46/IO45/IO39-42) avoiding all
            strapping pins. See docs/hardware.md §3.

    config BSP_UART1_RX_GPIO
        int "UART1 RX GPIO (protocol channel)"
        default 42
        help
            GPIO for UART1 RX (host protocol channel via CH343P).
            See BSP_UART1_TX_GPIO help for rationale (was GPIO11).

    config BSP_UART1_BAUD
        int "UART1 baud rate"
        default 115200
        help
            UART1 baud rate. Default 115200 8N1 per hardware.md §5.

    # ------------------------------------------------------------------
    # TMC2209 single-wire UART (for T5)
    # ------------------------------------------------------------------
    config BSP_TMC_UART_TX_GPIO
        int "TMC2209 UART TX GPIO"
        default 17
        help
            TMC2209 PDN_UART TX (through on-board 1kΩ resistor).
            Default matches docs/hardware.md §3 (GPIO17).
            Initialization is done in T5, not here.

    config BSP_TMC_UART_RX_GPIO
        int "TMC2209 UART RX GPIO"
        default 18
        help
            TMC2209 PDN_UART RX (direct connection).
            Default matches docs/hardware.md §3 (GPIO18).
            Initialization is done in T5, not here.

    # ------------------------------------------------------------------
    # Stepper signals (STEP / DIR / EN / DIAG)
    # ------------------------------------------------------------------
    config BSP_STEP_GPIO
        int "TMC2209 STEP GPIO"
        default 5
        help
            STEP pulse output. Default matches docs/hardware.md §3 (GPIO5).

    config BSP_DIR_GPIO
        int "TMC2209 DIR GPIO"
        default 6
        help
            DIR direction output. Default matches docs/hardware.md §3 (GPIO6).

    config BSP_EN_GPIO
        int "TMC2209 EN GPIO (active low)"
        default 21
        help
            TMC2209 ENN (enable, active low).
            Default matches docs/hardware.md §3 (GPIO21).
            Pulled HIGH (disabled) in bsp_early_init() as the very first
            peripheral action to avoid accidental enable during reset.

    config BSP_DIAG_GPIO
        int "TMC2209 DIAG1 GPIO"
        default 16
        help
            TMC2209 DIAG1 (stall / over-temperature indicator, input).
            Default matches docs/hardware.md §3 (GPIO16).

    # ------------------------------------------------------------------
    # I2C bus (AS5600 encoder)
    # ------------------------------------------------------------------
    config BSP_I2C_SDA_GPIO
        int "I2C SDA GPIO"
        default 8
        help
            I2C SDA (AS5600). Default matches docs/hardware.md §3 (GPIO8).

    config BSP_I2C_SCL_GPIO
        int "I2C SCL GPIO"
        default 9
        help
            I2C SCL (AS5600). Default matches docs/hardware.md §3 (GPIO9).

    config BSP_I2C_FREQ_HZ
        int "I2C clock frequency (Hz)"
        default 400000
        help
            I2C SCL frequency. Default 400kHz (Fast Mode).

    config BSP_AS5600_I2C_ADDR
        hex "AS5600 I2C 7-bit address"
        default 0x36
        help
            AS5600 default I2C address, per hardware.md §4 (0x36).

endmenu
```

## components/cartfsm/Kconfig
```kconfig
menu "cartfsm - 模式机"

config CARTFSM_TEST_HOOKS
    bool "编入流程测试注入钩子"
    default n
    help
        编入 cartfsm_test_* 注入钩子（命令直注、编码器失联注入、
        丢步偏差注入、标定状态复位）。仅供独立测试工程（test/，
        经其 sdkconfig 默认开启）使用，流程测试用例
        （test_cartfsm_flow.c）依赖这些钩子。

        与历史 FLOW_TEST 选项不同：本项不自动运行任何测试，仅暴露
        注入接口。正式固件保持关闭。

endmenu
```

## components/cartpos/Kconfig
```kconfig
menu "cartpos - 小车位置域"

choice CARTPOS_IMPL
    prompt "小车位置传感器实现"
    default CARTPOS_IMPL_AS5600

config CARTPOS_IMPL_AS5600
    bool "AS5600（I2C 磁编码器，4096 counts/rev）"

endchoice

endmenu
```

## components/cartproto/Kconfig
```kconfig
menu "cartproto - cartpole 线协议通讯栈"

    config CARTPROTO_UART_BAUD
        int "协议通道（UART0）波特率"
        default 460800
        range 9600 921600
        help
            与端侧（Hi3516CV610 / PC 联调）板对板链路的波特率，
            8N1。protocol.md 定为 460800；联调若不过降 230400。

    config CARTPROTO_LINE_TIMEOUT_MS
        int "不完整行超时（ms）"
        default 100
        range 10 5000
        help
            行首字节到行结尾 '\n' 之间允许的最大间隔。超时的不完整
            行被静默丢弃（protocol.md：非法行静默丢弃）。

endmenu
```

## components/ch224q/Kconfig
```kconfig
menu "ch224q - CH224Q PD 诱骗 I2C 调档"

    config CH224Q_I2C_ADDR
        hex "CH224Q I2C 7-bit 地址"
        default 0x22
        help
            CH224DS1 V2.0 给出 0x22/0x23 两种地址变体，本板为哪个
            待上板扫描确认（T9）。若 0x22 读失败改 0x23 重试。

endmenu
```

## components/gcode_parser/Kconfig
```kconfig
menu "G-code Parser Configuration"

config GCODE_PARSER_SELF_TEST
    bool "Run G-code parser self-test on boot"
    default n
    help
        When enabled, the firmware runs all 30 G-code parser unit tests
        during startup (before protocol stack init) and prints PASS/FAIL
        results to the serial console.  End summary line:
        "SELF-TEST DONE: <n>/30 PASS".

        This is for on-target verification only.  Keep disabled in
        production firmware (adds ~2KB flash, zero runtime overhead
        when disabled).

endmenu
```

## components/magnetic_encoder/Kconfig
```kconfig
menu "magnetic_encoder - 磁编码器类别"

config MAGNETIC_ENCODER_AS5600
    bool "编入 AS5600 实现（I2C，12-bit，小车编码器）"
    default y

config MAGNETIC_ENCODER_MT6835
    bool "编入 MT6835 实现（SPI，21-bit，摆角编码器）"
    default y

endmenu
```

## components/monitor/Kconfig
```kconfig
menu "Monitor / Telemetry"

config MONITOR_SELF_TEST
    bool "Run monitor telemetry self-test on boot"
    default n
    help
        Runs the telemetry self-test: TMC flag-mapping and frame
        formatting cases (pure logic) plus live '?'-frame and
        periodic-reporting checks.
        Final line: "SELF-TEST DONE: <n>/<total> PASS".

endmenu
```

## components/motor/Kconfig
```kconfig
menu "motor - 步进电机类别"

choice MOTOR_IMPL
    prompt "电机驱动实现"
    default MOTOR_IMPL_TMC2209

config MOTOR_IMPL_TMC2209
    bool "TMC2209（UART）+ GPTimer STEP/DIR 引擎"

endchoice

endmenu
```

## components/mt6835/Kconfig
```kconfig
menu "mt6835 - 摆角编码器"

config MT6835_SELF_TEST
    bool "上电运行 mt6835 自测"
    default n
    help
        启用后固件在启动时（mt6835_init 之后）运行自测：
        静止稳定性（1 s 内 raw21 抖动 ≤ 2 count）、读数连续有效、
        纯函数向量抽查。结束行 "SELF-TEST DONE: <n>/<total> PASS"。

endmenu
```

## components/planner/Kconfig
```kconfig
menu "Motion Planner"

config PLANNER_SELF_TEST
    bool "Run motion planner self-test on boot"
    default n
    help
        Runs all 21 planner self-tests during startup (after the step
        engine self-test, before TMC2209 init).  At that point the
        TMC2209 EN pin is still high, so the motor does not turn —
        only STEP/DIR levels are driven.

        Results are printed via ESP_LOG; the final line is
        "SELF-TEST DONE: <n>/21 PASS".

        For on-target verification only.  Keep disabled in production.

endmenu
```

## components/poleang/Kconfig
```kconfig
menu "poleang - 摆角域"

choice POLEANG_IMPL
    prompt "摆角编码器实现"
    default POLEANG_IMPL_MT6835

config POLEANG_IMPL_MT6835
    bool "MT6835（SPI 磁编码器，21-bit）"

endchoice

endmenu
```

## components/protocol/Kconfig
```kconfig
menu "Protocol - Communication Stack"

    config PROTOCOL_LINE_TIMEOUT_MS
        int "Line assembly timeout (ms)"
        default 100
        range 10 5000
        help
            Maximum time allowed between the first byte of a line and the
            line terminator (\n).  If a partial line sits in the buffer
            longer than this, it is discarded and error:3 is sent back.
            Default 100ms per PLAN T3 spec.

endmenu
```

## components/settings/Kconfig
```kconfig
menu "Settings (NVS Parameter Store)"

config SETTINGS_SELF_TEST
    bool "Run settings self-test on boot"
    default n
    help
        When enabled, the firmware runs all settings unit tests
        during startup (after settings_init, before protocol stack).
        Results printed via ESP_LOG, final summary line:
        "SELF-TEST DONE: <n>/<total> PASS" (tag: settings_selftest).

        For on-target verification only.  Keep disabled in production.

endmenu
```

## components/step_engine/Kconfig
```kconfig
menu "Step Engine (GPTimer ISR pulse generator)"

config STEP_ENGINE_TEST_HOOKS
    bool "编入 ISR 测试钩子插桩（间隔采样与周期计数）"
    default n
    help
        编入 step_selftest_* 钩子：ISR 发步间隔采样与分段周期计数。
        仅供独立测试工程（test/，经其 sdkconfig 默认开启）使用；
        开启后测试用例（test_step_engine.c）方可运行。

        与历史 SELF_TEST 选项不同：本项不自动运行任何测试，仅暴露
        插桩接口。正式固件保持关闭，保 ISR 热路径干净。

endmenu
```

## components/sysctl/Kconfig
```kconfig
menu "System Control"

config SYSCTL_SELF_TEST
    bool "Run sysctl state-machine / immediate-stop self-test on boot"
    default n
    help
        Runs the state-machine and '!' immediate-stop self-test.
        Final line: "SELF-TEST DONE: <n>/<total> PASS".

endmenu
```

## components/telemetry/Kconfig
```kconfig
menu "telemetry - 200 Hz STATE 流"

config TELEMETRY_SELF_TEST
    bool "上电运行 telemetry 组帧自测"
    default n
    help
        启用后在启动时运行组帧与换算向量自测，
        结束行 "SELF-TEST DONE: <n>/<total> PASS"。

endmenu
```

## components/tmc2209/Kconfig
```kconfig
menu "TMC2209 - Stepper Motor Driver (UART)"

    config TMC2209_RSENSE
        float "Sense resistor value (ohms)"
        default 0.11
        help
            Value of the current sense resistors on the board, in ohms.
            Default 0.11 — to be verified against schematic/BOM.
            Used for mA ↔ CS register conversion.

endmenu
```

## main/Kconfig
```kconfig
menu "Application"

config APP_JOINT_TEST
    bool "T5+T6 joint motion test (real motor, runs on boot)"
    default n
    help
        Enables the T5 (TMC2209) + T6 (step_engine) joint motion test.
        Runs automatically on boot after all subsystems are up.
        The motor physically moves — 12V motor supply required.
        Phases: A (forward 2 rev trapezoid), B (reverse back to 0),
        C (slow long move with '!' immediate stop via UART1).

config APP_M3_TEST
    bool "M3 joint test: real G-code lines via parser->planner->engine (real motor)"
    default n
    help
        Drives the full G-code chain with real command text: parser ->
        planner -> step_engine -> TMC2209 -> motor.  Verifies exact step
        counts for absolute/relative/sub-step moves, soft-limit rejection
        (error:2), and G92.  The motor physically moves — 12V required.
        Runs on boot after the G-code parser is registered.

endmenu
```

## sdkconfig.defaults
```kconfig
# ============================================================
# cartpole 固件 SDK 配置默认值
# 目标：ESP32-S3-WROOM-1-N16R8（16MB Quad Flash + 8MB Octal PSRAM）
# ============================================================

# ---- Target Chip ----
CONFIG_IDF_TARGET="esp32s3"

# ---- CPU & Clock ----
CONFIG_ESP_DEFAULT_CPU_FREQ_MHZ_240=y
CONFIG_ESP_DEFAULT_CPU_FREQ_MHZ=240

# ---- Flash ----
CONFIG_ESPTOOLPY_FLASHMODE_QIO=y
CONFIG_ESPTOOLPY_FLASHFREQ_80M=y
CONFIG_ESPTOOLPY_FLASHSIZE_16MB=y
CONFIG_ESPTOOLPY_FLASHSIZE="16MB"

# ---- Partition Table ----
CONFIG_PARTITION_TABLE_CUSTOM=y
CONFIG_PARTITION_TABLE_CUSTOM_FILENAME="partitions.csv"
CONFIG_PARTITION_TABLE_FILENAME="partitions.csv"

# ---- FreeRTOS ----
CONFIG_FREERTOS_HZ=1000

# ---- PSRAM (Octal, 8MB - N16R8) ----
CONFIG_SPIRAM=y
CONFIG_SPIRAM_MODE_OCT=y
CONFIG_SPIRAM_SPEED_80M=y
CONFIG_SPIRAM_USE_MALLOC=y
CONFIG_SPIRAM_MALLOC_ALWAYSINTERNAL=16384
CONFIG_SPIRAM_TRY_ALLOCATE_WIFI_LWIP=n
CONFIG_SPIRAM_MALLOC_RESERVE_INTERNAL=32768

# ---- Watchdog ----
# Interrupt watchdog on all cores
CONFIG_ESP_INT_WDT=y
CONFIG_ESP_INT_WDT_TIMEOUT_MS=300
CONFIG_ESP_INT_WDT_CHECK_CPU1=y

# Task watchdog (initialized at startup)
CONFIG_ESP_TASK_WDT_INIT=y
CONFIG_ESP_TASK_WDT_TIMEOUT_S=30
CONFIG_ESP_TASK_WDT_CHECK_IDLE_TASK_CPU0=y
CONFIG_ESP_TASK_WDT_CHECK_IDLE_TASK_CPU1=y
# Panic on task-WDT timeout：卡死任务无法再喂狗，带电机带电继续运行不可
# 接受，重启使故障可见可恢复。重启后 EN 为高（驱动不使能）、无运动目标。
# 代价：位置基准丢失，回零原点需重新建立（重新 HOME）。
CONFIG_ESP_TASK_WDT_PANIC=y

# ---- Logging ----
# Default log level: Info (can be overridden per-component at runtime)
# Note: Release build strips all ESP_LOG at compile time via CMakeLists.txt
CONFIG_LOG_DEFAULT_LEVEL_INFO=y
CONFIG_LOG_DEFAULT_LEVEL=3
CONFIG_LOG_MAXIMUM_LEVEL_DEBUG=y
CONFIG_LOG_COLORS=y
CONFIG_LOG_TIMESTAMP_SOURCE_RTOS=y

# ---- UART0 (console / log) ----
# rev2：日志/烧录走原生 USB（io19/20），UART0（43/44）整让给协议通道
CONFIG_ESP_CONSOLE_USB_SERIAL_JTAG=y

# ---- Timing ----
CONFIG_ESP_TIME_FUNCS_USE_ESP_TIMER=y
```

## test/sdkconfig.defaults
```kconfig
# 测试工程附加默认值（在 ../sdkconfig.defaults 之后应用）

# 分区表在仓库根（CUSTOM_FILENAME 相对本测试工程目录解析，需指回上级）
CONFIG_PARTITION_TABLE_CUSTOM_FILENAME="../partitions.csv"

# 测试钩子插桩（step_engine / cartfsm 流程测试用例依赖；正式固件关闭）
CONFIG_STEP_ENGINE_TEST_HOOKS=y
CONFIG_CARTFSM_TEST_HOOKS=y
```
